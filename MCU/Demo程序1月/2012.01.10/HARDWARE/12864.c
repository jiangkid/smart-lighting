#include "test.h"
#include "delay.h"
#include "12864.h"
/******************************************************************************/
u8 bLCDLine[LCDLINE_LENGTH]={0x7F,0x8F,0x87,0x97};
/******************************************************************************/
/****************************************************************
函数名称: WriteBit
功    能: 写一位，方便程序的查看和书写
参    数: bBit--写入的数据
返回值  : 无
****************************************************************/
void WriteBit(u8 bBit)  
{
	LCD_SCK=1;  //LCD_SCK=1
	Delay_Nus(10);
	if(bBit==1)  
		LCD_SID=1;  
	else if(bBit==0)  
		LCD_SID=0;
	Delay_Nus(10);
    LCD_SCK=0;  //LCD_SCK=0
	Delay_Nus(10);
}
/****************************************************************
函数名称: WriteByte
功    能: 读数据
参    数: Wbyte--写入的字节
返回值  : 无
****************************************************************/
void WriteByte(u8 Wbyte)  
{
	u8 i;
    for(i=0;i<8;i++)
	{
	    if(Wbyte&0x80)
            WriteBit(1);
        else
            WriteBit(0);
        Wbyte<<=1;
    }
}
/****************************************************************
函数名称: WriteCommand
功    能: 向LCD写入一字节的命令字
参    数: Cbyte--要写入的命令字节
返回值  : 无
****************************************************************/
void WriteCommand(u8 Cbyte)
{
	LCD_CS=1;     //LCD_CS=1
	/****发送五个"1",再发送"00",最后发送"0"****/
	WriteByte(0xF8); 
	Delay_Nus(50);
    /****先发送数据高四位,再发送四个"0"****/
	WriteByte(0xF0&Cbyte);
	Delay_Nus(50);
    /****先发送数据低四位,再发送四个"0"****/
	WriteByte(0xF0&Cbyte<<4);
	LCD_SCK=1;  //LCD_SCK=1
	Delay_Nus(1);
    LCD_SCK=0; //LCD_SCK=0
	Delay_Nus(50);
}
/****************************************************************
函数名称: WriteData
功    能: 向LCD写入一字节的数据
参    数: Cbyte--要写入的数据
返回值  : 无
****************************************************************/
void WriteData(u8 Dbyte)
{
	/****发送五个"1",再发送"01",最后发送"0"****/
	WriteByte(0xFA); 
	Delay_Nus(50);
    /****先发送数据高四位,再发送四个"0"****/
	WriteByte(0xF0&Dbyte); 
	Delay_Nus(50);
    /****先发送数据低四位,再发送四个"0"****/
	WriteByte(0xF0&Dbyte<<4);
	LCD_SCK=1;  //LCD_SCK=1
	Delay_Nus(1);
    LCD_SCK=0;  //LCD_SCK=0
	Delay_Nus(50);
}
/****************************************************************
函数名称: LCDInit
功    能: LCD初始化
参    数: 无
返回值  : 无
****************************************************************/
void LCDInit(void)
{
	LCD_CS=1;     //LCD_CS=1
    Delay_Nus(10);
 	WriteCommand(0x30);	//写入命令0x30,使用基本指令集
 	WriteCommand(0x0c);	//写入命令0x0c,整体显示,游标关,游标位置关
 	WriteCommand(0x01);	//写入命令0x01,LCD整体清屏
 	WriteCommand(0x06);	//写入命令0x06,游标右移,DDRAM位置计数器(AC)加1
	WriteCommand(0x0c);
 	Delay_Nms(5);
}
/****************************************************************
函数名称: LCDClear
功    能: 将LCD清屏，把DDRAM位址计数器调整为"00H"
参    数: 无
返回值  : 无
****************************************************************/
void LCDClear(void)
{
	WriteCommand(0x01);	//LCD清屏
	Delay_Nms(1);
}

/****************************************************************
函数名称: ClearLCD
功    能: LCD清屏，整体显示，游标关
参    数: 无
返回值  : 无
****************************************************************/
void ClearLCD(void)
{
 	LCDClear();				  	 //LCD清屏
	WriteCommand(0x0c);			 //写入命令0x0c,整体显示,游标关,游标位置关
	Delay_Nms(1);
}
/****************************************************************
函数名称: WriteLCDData
功    能: 在LCD上简易的显示字符串
参    数: bLine--字符串所处的行数，bNum--字符串所处的列数，bString--字符串
	  	  如(2,1,"我们")表示在第二行开头显示"我们"
返回值  : 无
****************************************************************/
void WriteLCDData(u8 bLine,u8 bNum,u8 bString[])
{
    u16 i;
	WriteCommand(bLCDLine[bLine-1]+bNum);		   
	for(i=0;i<mstrlen(bString);i++)		   
		WriteData(bString[i]);   
}
/****************************************************************
功能：12864的控制引脚定义
参数：NULL
返回：NULL
说明：CS-PB7; SID-PB8; SCK0PB9; 
****************************************************************/
void LCDPort_Init(void)
{
	RCC->APB2ENR|=1<<3;    //使能PORTB时钟

	GPIOB->CRL&=0X0FFFFFFF; 
	GPIOB->CRL|=0X60000000;//PB7开漏输出 
  	GPIOB->CRH&=0XFFFFFF00; 
	GPIOB->CRH|=0X00000066;//PB8,9 开漏输出 
}  
